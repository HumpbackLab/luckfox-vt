## sysdrv/source/buildroot/buildroot-2023.02.6/package/wfb-ng-min/Config.in
```kconfig
config BR2_PACKAGE_WFB_NG_MIN
	bool "wfb-ng-min"
	depends on BR2_INSTALL_LIBSTDCPP
	select BR2_PACKAGE_LIBEVENT
	select BR2_PACKAGE_LIBPCAP
	select BR2_PACKAGE_LIBSODIUM
	help
	  Build the minimum WFB-NG data plane binaries:
	  wfb_tx, wfb_rx, wfb_keygen and wfb_tun.

	  This package intentionally skips the Python control plane,
	  systemd integration, and helper services.

	  https://github.com/svpcom/wfb-ng
```
